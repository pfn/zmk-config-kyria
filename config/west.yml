## config/west.yml
```yaml
manifest:
  remotes:
    - name: zmkfirmware
      url-base: https://github.com/zmkfirmware
    - name: pfn
      url-base: https://github.com/pfn
  projects:
    - name: zmk
      remote: pfn
      revision: locality
      import: app/west.yml
  self:
    path: config
```
